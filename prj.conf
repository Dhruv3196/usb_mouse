## CMakeLists.txt
```
cmake_minimum_required(VERSION 3.20.0)
find_package(Zephyr REQUIRED HINTS $ENV{ZEPHYR_BASE})

project(radio_basic_tx)

target_sources(app PRIVATE src/main.c)
```

## prj.conf
```kconfig
CONFIG_USB_DEVICE_STACK=y
CONFIG_USB_DEVICE_HID=y
CONFIG_USB_DEVICE_PRODUCT="DHRUV'S MOSUE"
CONFIG_USB_DEVICE_PID=0x0007
CONFIG_USB_DEVICE_INITIALIZE_AT_BOOT=n

CONFIG_LOG=y
CONFIG_USB_DRIVER_LOG_LEVEL_ERR=y
CONFIG_USB_DEVICE_LOG_LEVEL_ERR=y
CONFIG_SENSOR=y
CONFIG_INPUT=y
CONFIG_PRINTK=y

CONFIG_LOG=y

CONFIG_USB_DEVICE_VID=0x1915


CONFIG_ENABLE_HID_INT_OUT_EP=y
```

## src/main.c
```c
#include <zephyr/kernel.h>
#include <zephyr/device.h>
#include <zephyr/drivers/gpio.h>
#include <zephyr/drivers/sensor.h>
#include <zephyr/input/input.h>
#include <zephyr/usb/usb_device.h>
#include <zephyr/usb/class/usb_hid.h>
#include <zephyr/sys/printk.h>
#include <zephyr/logging/log.h>

LOG_MODULE_REGISTER(main, LOG_LEVEL_INF);

static const struct gpio_dt_spec led0 = GPIO_DT_SPEC_GET(DT_ALIAS(led0), gpios);
static const uint8_t hid_report_desc[] = HID_MOUSE_REPORT_DESC(5);
static enum usb_dc_status_code usb_status;

#define MOUSE_BTN_LEFT 0
#define MOUSE_BTN_RIGHT 1
#define MOUSE_BTN_WHEEL 2
#define MOUSE_BTN_BACK 3
#define MOUSE_BTN_FORWARD 4

enum mouse_report_idx
{
    MOUSE_BTN_REPORT_IDX = 0,
    MOUSE_X_REPORT_IDX = 1,
    MOUSE_Y_REPORT_IDX = 2,
    MOUSE_WHEEL_REPORT_IDX = 3,
    MOUSE_REPORT_COUNT = 4,
};

static uint8_t report[MOUSE_REPORT_COUNT];

const struct device *const qdec_dev = DEVICE_DT_GET(DT_ALIAS(qdec0));

static bool report_updated = false;

static void status_cb(enum usb_dc_status_code status, const uint8_t *param)
{
    usb_status = status;
}

static ALWAYS_INLINE void rwup_if_suspended(void)
{
    if (IS_ENABLED(CONFIG_USB_DEVICE_REMOTE_WAKEUP))
    {
        if (usb_status == USB_DC_SUSPEND)
        {
            usb_wakeup_request();
            return;
        }
    }
}

static void input_cb(struct input_event *evt)
{
    uint8_t tmp[MOUSE_REPORT_COUNT];

    (void)memcpy(tmp, report, sizeof(tmp));

    switch (evt->code)
    {
    case INPUT_KEY_0:
        rwup_if_suspended();
        WRITE_BIT(tmp[MOUSE_BTN_REPORT_IDX], MOUSE_BTN_LEFT, evt->value);
        break;
    case INPUT_KEY_1:
        rwup_if_suspended();
        WRITE_BIT(tmp[MOUSE_BTN_REPORT_IDX], MOUSE_BTN_RIGHT, evt->value);
        break;
    case INPUT_KEY_4:
        rwup_if_suspended();
        WRITE_BIT(tmp[MOUSE_BTN_REPORT_IDX], MOUSE_BTN_WHEEL, evt->value);
        break;
    case INPUT_KEY_5:
        rwup_if_suspended();
        WRITE_BIT(tmp[MOUSE_BTN_REPORT_IDX], MOUSE_BTN_FORWARD, evt->value);
        break;

     case INPUT_KEY_6:
        rwup_if_suspended();
        WRITE_BIT(tmp[MOUSE_BTN_REPORT_IDX], MOUSE_BTN_BACK, evt->value);
        break;
    default:
        LOG_INF("Unrecognized input code %u value %d", evt->code, evt->value);
        return;
    }

    if (memcmp(tmp, report, sizeof(tmp)))
    {
        memcpy(report, tmp, sizeof(tmp));
        report_updated = true;
    }
}

static void qdec_fetch_and_handle(void)
{
    struct sensor_value val;
    int rc;

    rc = sensor_sample_fetch(qdec_dev);
    if (rc != 0)
    {
        printk("Failed to fetch QDEC sample (%d)\n", rc);
        return;
    }

    rc = sensor_channel_get(qdec_dev, SENSOR_CHAN_ROTATION, &val);
    if (rc != 0)
    {
        printk("Failed to get QDEC data (%d)\n", rc);
        return;
    }
   // printk("%d \n", val.val1);
    if (val.val1 > 0)
    {
        report[MOUSE_WHEEL_REPORT_IDX] += 5;
        report_updated = true;
    }
    else if (val.val1 < 0)
    {
        report[MOUSE_WHEEL_REPORT_IDX] -= 5;
        report_updated = true;
    }
}

INPUT_CALLBACK_DEFINE(NULL, input_cb);

int main(void)
{
    const struct device *hid_dev;
    int ret;

    if (!device_is_ready(qdec_dev))
    {
        printk("Qdec device is not ready\n");
        return 0;
    }

    if (!gpio_is_ready_dt(&led0))
    {
        LOG_ERR("LED device %s is not ready", led0.port->name);
        return 0;
    }

    hid_dev = device_get_binding("HID_0");
    if (hid_dev == NULL)
    {
        LOG_ERR("Cannot get USB HID Device");
        return 0;
    }

    usb_hid_register_device(hid_dev,
                            hid_report_desc, sizeof(hid_report_desc),
                            NULL);

    usb_hid_init(hid_dev);

    ret = usb_enable(status_cb);
    if (ret != 0)
    {
        LOG_ERR("Failed to enable USB");
        return 0;
    }

    ret = gpio_pin_configure_dt(&led0, GPIO_OUTPUT);
    if (ret < 0)
    {
        LOG_ERR("Failed to configure the LED pin, error: %d", ret);
        return 0;
    }

    while (true)
    {
        qdec_fetch_and_handle(); // Fetch QDEC data in each loop iteration

        if (report_updated)
        {
            ret = hid_int_ep_write(hid_dev, report, sizeof(report), NULL);
            if (ret)
            {
                LOG_ERR("HID write error, %d", ret);
            }

            report[MOUSE_X_REPORT_IDX] = 0U;
            report[MOUSE_Y_REPORT_IDX] = 0U;
            report[MOUSE_WHEEL_REPORT_IDX] = 0U;

            /* Toggle LED on sent report */
            ret = gpio_pin_toggle(led0.port, led0.pin);
            if (ret < 0)
            {
                LOG_ERR("Failed to toggle the LED pin, error: %d", ret);
            }
            report_updated = false;
        }
        k_usleep(1); // Sleep to prevent tight loop and allow other tasks to run
    }
    return 0;
}
```
